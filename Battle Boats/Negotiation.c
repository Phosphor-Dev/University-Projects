// **** Include libraries here ****
// Standard libraries
#include <stdio.h>
#include <string.h>
#include <stdint.h>

//CMPE13 Support Library
#include "BOARD.h"

// Microchip libraries
#include <xc.h>
#include <sys/attribs.h>

//CE13 standard libraries:
#include "Buttons.h"
#include "Uart1.h"
#include "Oled.h"

// Battleboats Libraries:
#include "BattleBoats.h"
#include "Agent.h"
#include "Negotiation.h"
#include "Message.h"
#include "Field.h"

/**
 * This function implements a one-way hash.  It maps its input, A, 
 * into an image, #a, in a way that is hard to reverse, but easy 
 * to reproduce.
 * @param secret        //A number that a challenger commits to
 * @return hash         //the hashed value of the secret commitment.
 *
 * This function implements the "Beef Hash," a variant of a Rabin hash.
 * The result is ((the square of the input) modulo the constant key 0xBEEF).
 * So, for example, 
 * 
 * NegotiationHash(3) == 9
 * NegotiationHash(12345) == 43182
 */
NegotiationData NegotiationHash(NegotiationData secret) {
    //put secret val through equation and return
    NegotiationData hashVal;
    return (hashVal = ((secret * secret) % PUBLIC_KEY));
}

/**
 * Detect cheating.  An accepting agent will receive both a commitment hash
 * and a secret number from the challenging agent.  This function
 * verifies that the secret and the commitment hash agree, hopefully
 * detecting cheating by the challenging agent.
 *
 * @param secret        //the previously secret number that the challenging agent has revealed
 * @param commitment    //the hash of the secret number
 * @return TRUE if the commitment validates the revealed secret, FALSE otherwise
 */
int NegotiationVerify(NegotiationData secret, NegotiationData commitment) {
    //put secret val through equation and compare against hash provided
    NegotiationData hashval = ((secret * secret) % PUBLIC_KEY);
    if (hashval == commitment) {
        return (TRUE);
    } else {
        return (FALSE);
    }
}

/**
 * The coin-flip protocol uses random numbers generated by both
 * agents to determine the outcome of the coin flip.
 *
 * The parity of a bitstring is 1 if there are an odd number of one bits,
 *   and 0 otherwise.
 * So, for example, the number 0b01101011 has 5 ones. If the parity of
 * A XOR B is 1, then the outcome is HEADS.  Otherwise, the outcome is TAILS.
 */
NegotiationOutcome NegotiateCoinFlip(NegotiationData A, NegotiationData B) {
    //xor the given values and use bit manipulation to count 1's
    uint16_t cmpStr = A ^ B;
    int bitCounter = 0;
    while (cmpStr) {
        if ((cmpStr & 0x0001) == 1) {
            bitCounter++;
        }
        cmpStr = cmpStr >> 1;
    }
    //if even, Parity is even, return TAILS, else HEADS
    if (bitCounter % 2 == 0) {
        return (TAILS);
    } else {
        return (HEADS);
    }
}


/**
 * Extra credit: 
 * Use either or both of these two functions if you want to generate a "cheating" agent.  
 *
 * To get extra credit, define these functions 
 * and use these functions in agent.c to generate A and/or B
 * 
 * Your agent only needs to be able to cheat at one role for extra credit.  They must result in 
 * your agent going first more than 75% of the time in that role when
 * competing against a fair agent (that is, an agent that uses purely random A and B).
 *
 * You must state that you did this at the top of your README, and describe your 
 * strategy thoroughly.
 */
NegotiationData NegotiateGenerateBGivenHash(NegotiationData hash_a);
NegotiationData NegotiateGenerateAGivenB(NegotiationData B);
